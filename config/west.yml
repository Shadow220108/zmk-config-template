## config/west.yml
```yaml
manifest:
  remotes:
    - name: zmkfirmware
      url-base: https://github.com/zmkfirmware
  projects:
    - name: zmk
      remote: zmkfirmware
      revision: main
      import: app/west.yml
  self:
    path: config
jobs:
  build:
    uses: zmkfirmware/zmk/.github/workflows/build-user-config.yml@main
    with:
      build_matrix: |
        - board: seeeduino_xiao_ble
          shield: SHADOW_SPT_left
        - board: seeeduino_xiao_ble
          shield: SHADOW_SPT_right
```
